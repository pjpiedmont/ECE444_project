## rtu/main/Kconfig.projbuild
```kconfig
menu "Modbus Slave Configuration"

    config MB_SLAVE_ADDR
        int "Modbus slave address"
        range 1 255
        default 1
        help
            This is the Modbus slave address in the network.
            The address is used as an index to resolve slave ip address.

    config MB_MDNS_IP_RESOLVER
        bool "Resolve slave addresses using mDNS service"
        default y
        help
            This option allows to use mDNS service to resolve IP addresses of the Modbus slaves.
            If the option is disabled the ip addresses of slaves are defined in static table.

endmenu

menu "I2C Configuration"

    config I2C_MASTER_SCL
        int "SCL GPIO Num"
        default 6 if IDF_TARGET_ESP32C3
        default 19 if IDF_TARGET_ESP32 || IDF_TARGET_ESP32S2 || IDF_TARGET_ESP32S3
        help
            GPIO number for I2C Master clock line.

    config I2C_MASTER_SDA
        int "SDA GPIO Num"
        default 5 if IDF_TARGET_ESP32C3
        default 18 if IDF_TARGET_ESP32 || IDF_TARGET_ESP32S2 || IDF_TARGET_ESP32S3
        help
            GPIO number for I2C Master data line.

endmenu
```
